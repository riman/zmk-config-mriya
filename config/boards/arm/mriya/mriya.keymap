/*
 * Copyright (c) 2023 Andrei Gaevskii
 *
 * SPDX-License-Identifier: MIT
 */

#include <behaviors.dtsi>
#include <dt-bindings/zmk/keys.h>
#include <dt-bindings/zmk/bt.h>

&lt {
    tapping-term-ms = <180>;
    quick_tap_ms = -1;
};

&mt {
    tapping-term-ms = <180>;
    quick_tap_ms = -1;
};

/ {
    keymap {
        compatible = "zmk,keymap";

        default_layer {
            bindings = <
            &none         &none         &none         &none         &none         &none           &none         &none         &none         &none         &none        &none
     &none  &none         &none         &none         &none         &none         &none           &none         &none         &none         &none         &none        &none  &none
            &none         &none         &none         &none         &none         &none           &none         &none         &none         &none         &none        &none
            &none         &none         &none         &none         &none         &none           &none         &none         &none         &none         &none        &none
                                        &none         &none         &none         &none           &none         &none         &none         &none
        };
    };
};
